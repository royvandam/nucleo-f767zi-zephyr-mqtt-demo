## CMakeLists.txt
```
cmake_minimum_required(VERSION 3.13.1)
find_package(Zephyr REQUIRED HINTS $ENV{ZEPHYR_BASE})
project(pcu)

FILE(GLOB app_sources
    src/*.c
    src/*.cpp
    src/*.h)
target_sources(app PRIVATE ${app_sources})
```

## prj.conf
```kconfig
# Logging
CONFIG_PRINTK=y
CONFIG_LOG=y
CONFIG_LOG_STRDUP_BUF_COUNT=32
CONFIG_NET_LOG=y
CONFIG_NET_STATISTICS=y
CONFIG_STDOUT_CONSOLE=y

# Shell
CONFIG_KERNEL_SHELL=y
CONFIG_SHELL=y

# Network
CONFIG_NETWORKING=y
CONFIG_NET_SHELL=y
CONFIG_NET_UDP=y
CONFIG_NET_IPV4=y
CONFIG_NET_IPV6=n
CONFIG_NET_TCP=y
# CONFIG_NET_DHCPV4=n
CONFIG_NET_SOCKETS=y
CONFIG_NET_SOCKETS_POSIX_NAMES=y

# CONFIG_NET_MGMT=y
# CONFIG_NET_MGMT_EVENT=y

CONFIG_NET_BUF_DATA_SIZE=256

CONFIG_NET_CONFIG_SETTINGS=y
# CONFIG_NET_CONFIG_MY_IPV4_ADDR="192.0.2.1"
# CONFIG_NET_CONFIG_MY_IPV4_GW="192.0.2.2"
CONFIG_NET_CONFIG_MY_IPV4_ADDR="10.0.0.32"
CONFIG_NET_CONFIG_MY_IPV4_GW="10.0.0.1"

# Kernel options
CONFIG_MAIN_STACK_SIZE=2048
CONFIG_INIT_STACKS=y
CONFIG_ENTROPY_GENERATOR=y
CONFIG_TEST_RANDOM_GENERATOR=y
# CONFIG_FPU=y

# C/C++ Library
CONFIG_NEWLIB_LIBC=y
CONFIG_CPLUSPLUS=y
CONFIG_STD_CPP17=y
CONFIG_LIB_CPLUSPLUS=y

# Libraries
CONFIG_MQTT_LIB=y
CONFIG_MQTT_KEEPALIVE=30
# CONFIG_MQTT_LOG_LEVEL_DBG=y

# Debug
CONFIG_DEBUG_INFO=y
CONFIG_OPENOCD_SUPPORT=y
CONFIG_THREAD_STACK_INFO=y
CONFIG_THREAD_MONITOR=y
CONFIG_THREAD_NAME=y

# Qemu Cortex M3 ethernet
# CONFIG_NET_L2_ETHERNET=y
# CONFIG_NET_QEMU_ETHERNET=y
# CONFIG_ETH_STELLARIS=y
# CONFIG_NET_SLIP_TAP=n
# CONFIG_SLIP=n
```

## src/main.c
```c
#include <logging/log.h>
LOG_MODULE_REGISTER(pcu, LOG_LEVEL_DBG);

#include "network.h"
#include "mqtt_service.h"
#include <random/rand32.h>

#include <zephyr.h>

#define SW0_NODE	DT_ALIAS(sw0)
#define SW0_GPIO_LABEL	DT_GPIO_LABEL(SW0_NODE, gpios)
#define SW0_GPIO_PIN	DT_GPIO_PIN(SW0_NODE, gpios)

#define LED0_NODE	DT_ALIAS(led0)
#define LED0_GPIO_LABEL	DT_GPIO_LABEL(LED0_NODE, gpios)
#define LED0_GPIO_PIN	DT_GPIO_PIN(LED0_NODE, gpios)

#define LED1_NODE	DT_ALIAS(led1)
#define LED1_GPIO_LABEL	DT_GPIO_LABEL(LED1_NODE, gpios)
#define LED1_GPIO_PIN	DT_GPIO_PIN(LED1_NODE, gpios)

#define LED2_NODE	DT_ALIAS(led2)
#define LED2_GPIO_LABEL	DT_GPIO_LABEL(LED2_NODE, gpios)
#define LED2_GPIO_PIN	DT_GPIO_PIN(LED2_NODE, gpios)

/* MQTT client */
#define MQTT_CLIENTID           "fancom_pcu"

/* MQTT Broker address information. */
#define MQTT_BROKER_ADDR        "10.0.0.131"
#define MQTT_BROKER_PORT		1883


static void publish(struct mqtt_service* service,
    const char* topic, enum mqtt_qos qos,
    const char* value)
{
    struct mqtt_client* client = (struct mqtt_client*)&service->client;

	struct mqtt_publish_param param;

	param.message.topic.qos = qos;
	param.message.topic.topic.utf8 = topic;
	param.message.topic.topic.size = strlen(topic);
	param.message.payload.data = value;
	param.message.payload.len = strlen(value);
	param.message_id = sys_rand32_get();
	param.dup_flag = 0U;
	param.retain_flag = 1U;

	mqtt_publish(client, &param);
}

static mqtt_service_t mqtt_service;

#define TOPIC_A "pcu/sensor/a"
#define TOPIC_B "pcu/sensor/b"
#define TOPIC_C "pcu/sensor/c"

void main(void) {
	network_init();

    mqtt_service_init(&mqtt_service, MQTT_CLIENTID, MQTT_BROKER_ADDR, MQTT_BROKER_PORT);
    mqtt_service_start(&mqtt_service);

    while (mqtt_service.state != MQTT_SERVICE_CONNECTED) {
        k_sleep(K_MSEC(1000));
    }

    struct mqtt_topic topics[] = {
        { .qos = MQTT_QOS_0_AT_MOST_ONCE,  .topic = MQTT_UTF8_LITERAL(TOPIC_A) },
        // { .qos = MQTT_QOS_1_AT_LEAST_ONCE, .topic = MQTT_UTF8_LITERAL(TOPIC_B) },
        // { .qos = MQTT_QOS_2_EXACTLY_ONCE,  .topic = MQTT_UTF8_LITERAL(TOPIC_C) },
    };

    LOG_INF("Topic: %s", topics[0].topic.utf8);

    struct mqtt_subscription_list subscriptions = {
        .list = topics,
        .list_count = 1,
        .message_id = sys_rand32_get()
    };

    mqtt_subscribe((struct mqtt_client*)&mqtt_service.client, &subscriptions);
    k_sleep(K_MSEC(1000));

    while (1) {
        static char value[30];
        snprintk(value, sizeof(value), "{d:{value:%d}", (uint8_t)sys_rand32_get());

        publish(&mqtt_service, TOPIC_A, MQTT_QOS_0_AT_MOST_ONCE, value);
        // publish(&mqtt_service, TOPIC_B, MQTT_QOS_1_AT_LEAST_ONCE, value);
        // publish(&mqtt_service, TOPIC_C, MQTT_QOS_2_EXACTLY_ONCE, value);

        k_sleep(K_MSEC(5000));
    }


    // GPIO::Output led[3] = {
    //     GPIO::Output(device_get_binding(LED0_GPIO_LABEL), LED0_GPIO_PIN, GPIO_OUTPUT_INIT_LOW),
    //     GPIO::Output(device_get_binding(LED0_GPIO_LABEL), LED0_GPIO_PIN, GPIO_OUTPUT_INIT_LOW),
    //     GPIO::Output(device_get_binding(LED0_GPIO_LABEL), LED0_GPIO_PIN, GPIO_OUTPUT_INIT_LOW)
    // };

    // GPIO::Input button(
    //     device_get_binding(SW0_GPIO_LABEL), SW0_GPIO_PIN);
    // button.set_interrupt_mode(GPIO_INT_EDGE_RISING);
    // button.set_interrupt_handle([](int value){
    //     printk("Button pressed: %d", value);
    // });

}
```

## src/main.cpp
```c
#include <logging/log.h>
LOG_MODULE_REGISTER(pcu, LOG_LEVEL_DBG);

#include "network.h"
#include "gpio.h"
#include "mqtt_service.h"

#include <zephyr.h>
#include <stdlib.h>
#include <random/rand32.h>

#define SW0_NODE	DT_ALIAS(sw0)
#define SW0_GPIO_LABEL	DT_GPIO_LABEL(SW0_NODE, gpios)
#define SW0_GPIO_PIN	DT_GPIO_PIN(SW0_NODE, gpios)

#define LED0_NODE	DT_ALIAS(led0)
#define LED0_GPIO_LABEL	DT_GPIO_LABEL(LED0_NODE, gpios)
#define LED0_GPIO_PIN	DT_GPIO_PIN(LED0_NODE, gpios)

#define LED1_NODE	DT_ALIAS(led1)
#define LED1_GPIO_LABEL	DT_GPIO_LABEL(LED1_NODE, gpios)
#define LED1_GPIO_PIN	DT_GPIO_PIN(LED1_NODE, gpios)

#define LED2_NODE	DT_ALIAS(led2)
#define LED2_GPIO_LABEL	DT_GPIO_LABEL(LED2_NODE, gpios)
#define LED2_GPIO_PIN	DT_GPIO_PIN(LED2_NODE, gpios)

static GPIO::Output led[] = {
    GPIO::Output(device_get_binding(LED0_GPIO_LABEL), LED0_GPIO_PIN, GPIO_OUTPUT_INIT_LOW),
    GPIO::Output(device_get_binding(LED0_GPIO_LABEL), LED1_GPIO_PIN, GPIO_OUTPUT_INIT_LOW),
    GPIO::Output(device_get_binding(LED0_GPIO_LABEL), LED2_GPIO_PIN, GPIO_OUTPUT_INIT_LOW)
};

static GPIO::Input sw[] = {
    GPIO::Input(device_get_binding(SW0_GPIO_LABEL), SW0_GPIO_PIN)
};

// MQTT client
#define MQTT_CLIENTID           "pcu:42"

// MQTT broker address information
#define MQTT_BROKER_ADDR        "10.0.0.131"
#define MQTT_BROKER_PORT		1883

// MQTT topic definitions
#define MQTT_TOPIC_DEVICE "pcu"
// #define MQTT_TOPIC_DEV_UUID "378cac49-a79e-4634-b343-7057a7878f03"
#define MQTT_TOPIC_UUID "42"
#define MQTT_TOPIC_PREFIX   "dev/" MQTT_TOPIC_DEVICE "/uuid/" MQTT_TOPIC_UUID
#define MQTT_TOPIC_LED_0    MQTT_TOPIC_PREFIX "/out/led/0"
#define MQTT_TOPIC_LED_1    MQTT_TOPIC_PREFIX "/out/led/1"
#define MQTT_TOPIC_LED_2    MQTT_TOPIC_PREFIX "/out/led/2"
#define MQTT_TOPIC_SW_0     MQTT_TOPIC_PREFIX "/in/sw/0"

static mqtt_service_t mqtt_service;

static int mqtt_update_led_state(struct mqtt_service* service, size_t payload_len, int index) {
    if (payload_len != 1) {
        LOG_ERR("Invalid payload length");
        return -1;
    }
    char value[2] = {0};
    if (mqtt_service_read_payload(service, &value, 1) < 0) {
        return -1;
    }

    led[index].set(atoi(value));

    return 0;
}

static int mqtt_topic_callback(struct mqtt_service* service, const char* topic, size_t payload_len) {
    if (strcmp(MQTT_TOPIC_LED_0, topic) == 0) {
        return mqtt_update_led_state(service, payload_len, 0);
    } else if (strcmp(MQTT_TOPIC_LED_1, topic) == 0) {
        return mqtt_update_led_state(service, payload_len, 1);
    } else if (strcmp(MQTT_TOPIC_LED_2, topic) == 0) {
        return mqtt_update_led_state(service, payload_len, 2);
    }

    LOG_ERR("Unexpected topic: %s", log_strdup(topic));
    return -1;
}

void main(void) {
	network_init();
    k_sleep(K_MSEC(1000));

    mqtt_service_init(&mqtt_service,
        MQTT_CLIENTID,
        MQTT_BROKER_ADDR, MQTT_BROKER_PORT,
        mqtt_topic_callback);
    mqtt_service_start(&mqtt_service);

    while (mqtt_service.state != MQTT_SERVICE_CONNECTED) {
        k_sleep(K_MSEC(1000));
    }

    char initial_value = '0';
    mqtt_service_publish(&mqtt_service, MQTT_TOPIC_SW_0, MQTT_QOS_0_AT_MOST_ONCE, &initial_value, sizeof(initial_value));
    mqtt_service_subscribe(&mqtt_service, MQTT_TOPIC_LED_0, MQTT_QOS_0_AT_MOST_ONCE, &initial_value, sizeof(initial_value));
    mqtt_service_subscribe(&mqtt_service, MQTT_TOPIC_LED_1, MQTT_QOS_0_AT_MOST_ONCE, &initial_value, sizeof(initial_value));
    mqtt_service_subscribe(&mqtt_service, MQTT_TOPIC_LED_2, MQTT_QOS_0_AT_MOST_ONCE, &initial_value, sizeof(initial_value));

    sw[0].set_interrupt(GPIO_INT_EDGE_BOTH | GPIO_INT_DEBOUNCE);
    sw[0].set_interrupt_handler([](GPIO::Input&, int value) {
        char strbuf[2];
        snprintf(strbuf, sizeof(strbuf), "%d", value);
        mqtt_service_publish(&mqtt_service,
            MQTT_TOPIC_SW_0, MQTT_QOS_0_AT_MOST_ONCE, strbuf, 1);
        LOG_INF("Button SW0: %s", value ? "pressed" : "released");
    });

    while (1) {
        k_sleep(K_MSEC(10000));
    }
}
```

## src/gpio.cpp
```c
#include "gpio.h"
#include <assert.h>

namespace GPIO {

Pin::Pin(struct device* dev, gpio_pin_t pin, gpio_flags_t flags)
    : _dev(dev)
    , _pin(pin)
{
    int ret = gpio_pin_configure(_dev, _pin, flags);
    assert(ret == 0);
}

Pin::~Pin() {
    gpio_pin_configure(_dev, _pin, GPIO_DISCONNECTED);
}

int
Pin::get() const {
    return gpio_pin_get(_dev, _pin);
}

Pin::operator int() const {
    return gpio_pin_get(_dev, _pin);
}

Output::Output(struct device* dev, gpio_pin_t pin, gpio_flags_t init_state)
    : Pin(dev, pin, GPIO_OUTPUT | init_state)
{}

void
Output::set(int value) {
    gpio_pin_set(_dev, _pin, value);
}

void
Output::toggle() {
    gpio_pin_toggle(_dev, _pin);
}

Output& Output::operator=(Output& other) {
    set(other);
    return *this;
}

Output& Output::operator=(int value) {
    set(value);
    return *this;
}

Input::Input(struct device* dev, gpio_pin_t pin)
    : Pin(dev, pin, GPIO_INPUT)
{}

void
Input::set_interrupt(gpio_flags_t mode) {
    int ret = gpio_pin_interrupt_configure(_dev, _pin, mode);
    assert(ret == 0);
}

void
Input::set_interrupt_handler(InterruptHandler handler) {
    _interrupt_handler = handler;
    _interrupt_callback.context = this;
    auto cb = reinterpret_cast<gpio_callback*>(&_interrupt_callback.base);
    gpio_init_callback(cb, Input::_raw_interrupt_handler, BIT(this->_pin));
	gpio_add_callback(this->_dev, cb);
}

void
Input::clear_interrupt_handler() {
    if (_interrupt_handler) {
        auto cb = reinterpret_cast<gpio_callback*>(&_interrupt_callback.base);
        gpio_remove_callback(this->_dev, cb);
        _interrupt_handler = nullptr;
    }
}

void Input::_base_interrupt_handler() {
    if (_interrupt_handler) {
        _interrupt_handler(*this, get());
    }
}

void
Input::_raw_interrupt_handler(struct device *dev __unused,
    struct gpio_callback *cb, uint32_t pin __unused)
{
    auto self = reinterpret_cast<Input*>(
        reinterpret_cast<Input::InterruptCallback*>(cb)->context);
    self->_base_interrupt_handler();
}

} // namespace GPIO
```

## src/gpio.h
```c
#pragma once

#include <device.h>
#include <drivers/gpio.h>

#include <functional>

namespace GPIO {

class Pin
{
public:
    ~Pin();

    int get() const;
    operator int() const;

protected:
    Pin(struct device* dev, gpio_pin_t pin, gpio_flags_t flags);

    struct device* _dev;
    gpio_pin_t _pin;
};

class Output
    : public Pin
{
public:
    Output(struct device* dev,
           gpio_pin_t pin,
           gpio_flags_t init = GPIO_OUTPUT_INIT_LOW);

    void set(int value);
    void toggle();

    Output& operator=(Output& other);
    Output& operator=(int value);
};

class Input
    : public Pin
{
public:
    Input(struct device* dev, gpio_pin_t pin);

    using InterruptHandler = std::function<void(Input&, int)>;
    void set_interrupt(gpio_flags_t mode);
    void set_interrupt_handler(InterruptHandler handler);
    void clear_interrupt_handler();

protected:
    struct InterruptCallback {
        gpio_callback base;
        void* context;
    } _interrupt_callback;
    InterruptHandler _interrupt_handler;

    void _base_interrupt_handler();
    static void _raw_interrupt_handler(struct device *dev,
        struct gpio_callback *cb, uint32_t pin);
};

}
```

## src/mqtt_service.c
```c
#include "mqtt_service.h"

#include <net/socket.h>
#include <net/mqtt.h>
#include <random/rand32.h>

#include <logging/log.h>
LOG_MODULE_REGISTER(mqtt_service, LOG_LEVEL_INF);

#define NULL_PARAM_CHECK(param) \
	do { \
		if ((param) == NULL) { \
			return -EINVAL; \
		} \
	} while (0)

#define NULL_PARAM_CHECK_VOID(param) \
	do { \
		if ((param) == NULL) { \
			return; \
		} \
	} while (0)

static int _mqtt_service_discard_payload(struct mqtt_service* self, size_t len) {
    struct mqtt_client* client = (struct mqtt_client*)&self->client;

    int bytes_read = 0;
    while (bytes_read < len) {
        uint8_t buffer[32] = {0};
        size_t remaining = len - bytes_read;

        int ret = mqtt_read_publish_payload(client, buffer, MIN(remaining, sizeof(buffer)));
        if (ret < 0 && ret != -EAGAIN) {
            LOG_ERR("mqtt_read_publish_payload: %d", ret);
            return ret;
        } else if(ret == -EAGAIN) {
            return 0;
        }

        bytes_read += ret;
    }

    return 0;
}

int mqtt_service_read_payload(struct mqtt_service* self, void* buffer, size_t len) {
    struct mqtt_client* client = (struct mqtt_client*)&self->client;

    NULL_PARAM_CHECK(self);
    NULL_PARAM_CHECK(buffer);

    int ret = mqtt_read_publish_payload_blocking(client, buffer, len);
    if (ret < 0) {
        LOG_ERR("mqtt_read_publish_payload_block: %d", ret);
        return ret;
    } 

    return 0;
}

static void _mqtt_service_evt_handler(struct mqtt_client *client, const struct mqtt_evt *evt)
{
    struct mqtt_service* self = ((struct mqtt_service_client*)client)->context;

    int err;

    switch (evt->type) {
    case MQTT_EVT_CONNACK:
        if (evt->result != 0) {
            LOG_ERR("MQTT connect failed %d", evt->result);
            break;
        }

        self->state = MQTT_SERVICE_CONNECTED;
        LOG_INF("Connected!");
        break;

    case MQTT_EVT_DISCONNECT:
        LOG_INF("Disconnected: %d", evt->result);
        self->state = MQTT_SERVICE_DISCONNECTED;
        break;

    case MQTT_EVT_PUBLISH:
		if (evt->result != 0) {
			LOG_ERR("PUBLISH error %d", evt->result);
			break;
		}

        // Parse topic in to string buffer
        char topic[MQTT_MAX_TOPIC_LEN];
        size_t topic_len = MIN(evt->param.publish.message.topic.topic.size, MQTT_MAX_TOPIC_LEN);
        if (evt->param.publish.message.topic.topic.size > MQTT_MAX_TOPIC_LEN) {
            LOG_WRN("Truncating %d bytes from the topic", evt->param.publish.message.topic.topic.size - topic_len);
        }
        strncpy(topic, evt->param.publish.message.topic.topic.utf8, topic_len);
        topic[topic_len] = '\0';
		LOG_DBG("PUBLISH on topic: %s", log_strdup(topic));

        // Invoke callback handler to read and parse the message payload
        size_t payload_len = evt->param.publish.message.payload.len;
        if (self->callback == NULL || self->callback(self, topic, payload_len) < 0) {
            // The callback is either not set or did not return successfully. Discard the pending data in order
            // to prevent the process handler for going mental on the remaining bytes in the buffer.
            // It has cost me at least a f*$&ng day to figure this one out...
            LOG_WRN("Discarding %d bytes of payload", payload_len);
            _mqtt_service_discard_payload(self, payload_len);
        }

        // Reply to the broker we received the message in good order.
        switch (evt->param.publish.message.topic.qos) {
            case MQTT_QOS_1_AT_LEAST_ONCE: {
                const struct mqtt_puback_param param = {
                    .message_id = evt->param.publish.message_id
                };

                err = mqtt_publish_qos1_ack(client, &param);
                if (err != 0) {
                    LOG_ERR("Failed to send PUBACK: %d", err);
                }
            } break;

            case MQTT_QOS_2_EXACTLY_ONCE: {
                const struct mqtt_pubrec_param param = {
                    .message_id = evt->param.publish.message_id
                };

                err = mqtt_publish_qos2_receive(client, &param);
                if (err != 0) {
                    LOG_ERR("Failed to send PUBREC: %d", err);
                }
            } break;
        }
        break;

    case MQTT_EVT_PUBACK:
		if (evt->result != 0) {
			LOG_ERR("PUBACK error %d", evt->result);
			break;
		}

		LOG_DBG("PUBACK packet id: %u", evt->param.puback.message_id);
		break;

    case MQTT_EVT_PUBREC: {
		if (evt->result != 0) {
			LOG_ERR("PUBREC error %d", evt->result);
			break;
		}
		LOG_DBG("PUBREC packet id: %u", evt->param.pubrec.message_id);

		const struct mqtt_pubrel_param param = {
			.message_id = evt->param.pubrec.message_id
		};

		err = mqtt_publish_qos2_release(client, &param);
		if (err != 0) {
			LOG_ERR("Failed to send PUBREL: %d", err);
		}
    } break;

    case MQTT_EVT_PUBREL: {
		if (evt->result != 0) {
			LOG_ERR("PUBREL error %d", evt->result);
			break;
		}
		LOG_DBG("PUBREL packet id: %u", evt->param.pubrel.message_id);
        
		const struct mqtt_pubcomp_param param = {
			.message_id = evt->param.pubrel.message_id
		};

		err = mqtt_publish_qos2_complete(client, &param);
		if (err != 0) {
			LOG_ERR("Failed to send PUBCOMP: %d", err);
		}
    } break;

	case MQTT_EVT_PUBCOMP:
		if (evt->result != 0) {
			LOG_ERR("PUBCOMP error %d", evt->result);
			break;
		}

		LOG_DBG("PUBCOMP packet id: %u", evt->param.pubcomp.message_id);
		break;

    case MQTT_EVT_SUBACK:
		if (evt->result != 0) {
			LOG_ERR("SUBACK error %d", evt->result);
			break;
		}
		LOG_DBG("SUBACK packet id: %u", evt->param.suback.message_id);
        break;

    case MQTT_EVT_UNSUBACK:
		if (evt->result != 0) {
			LOG_ERR("UNSUBACK error %d", evt->result);
			break;
		}
		LOG_DBG("UNSUBACK packet id: %u", evt->param.unsuback.message_id);
        break;

	case MQTT_EVT_PINGRESP:
		LOG_DBG("PINGRESP packet");
		break;

	default:
		break;
	}
}

static int _mqtt_service_wait(struct mqtt_service *self, int timeout) {
    struct mqtt_client* client = (struct mqtt_client*)&self->client;
    struct pollfd fds[1];

    fds[0].fd = client->transport.tcp.sock;
    fds[0].events = ZSOCK_POLLIN;

    int ret = zsock_poll(fds, 1, timeout);
    if (ret < 0) {
        LOG_ERR("poll error: %d", errno);
    }

    if (fds[0].revents & ZSOCK_POLLHUP) {
        LOG_WRN("poll HUP event");
    }

	return ret;
}

static int _mqtt_service_connect(struct mqtt_service* self, int attempts) {
    struct mqtt_client* client = (struct mqtt_client*)&self->client;
    int rc, attempt = 0;

    while (attempt++ < attempts && self->state != MQTT_SERVICE_CONNECTED) {
        LOG_INF("Connecting to broker... (%d/%d)", attempt, attempts);
        rc = mqtt_connect(client);
        if (rc != 0) {
            LOG_ERR("mqtt_connect: %d", rc);
            k_sleep(K_MSEC(1000));
            continue;
        }

        if (_mqtt_service_wait(self, 5000)) {
            rc = mqtt_input(client);
            if (rc != 0) {
                LOG_ERR("mqtt_input: %d", rc);
            }
        }

        if (self->state != MQTT_SERVICE_CONNECTED) {
            LOG_WRN("Failed to connect");
			mqtt_abort(client);
		} else {
            return 0;
        }
    }

    return -1;
}

static int _mqtt_service_process(struct mqtt_service* self) {
    struct mqtt_client* client = (struct mqtt_client*)&self->client;
    int rc = 0;

    if (_mqtt_service_wait(self, 1000) != 0) {
        rc = mqtt_input(client);
        if (rc != 0) {
            LOG_ERR("mqtt_input: %d", rc);
        }
    } else {
        rc = mqtt_live(client);
        if (rc != 0 && rc != -EAGAIN) {
            LOG_ERR("mqtt_live: %d", rc);
        }
    }

    return rc;
}

static void _mqtt_service_task(void* context, void* b __unused, void* c __unused) {
    struct mqtt_service* self = (struct mqtt_service*)(context);

    while(1) {
        switch (self->state) {
            case MQTT_SERVICE_DISCONNECTED:
                // Connect to MQTT broker
                if (_mqtt_service_connect(self, 5) != 0) {
                    LOG_ERR("Unable to connect");
                    LOG_INF("Retrying in 30 sec...");
                    k_sleep(K_SECONDS(30));
                }
                break;
            
            case MQTT_SERVICE_CONNECTED:
                // Process MQTT communication
                _mqtt_service_process(self);
                break;

            default: return;
        }
    }
}

void mqtt_service_init(struct mqtt_service* self,
    const char* client_id,
    const char* broker_addr, uint16_t broker_port,
    mqtt_service_callback_t callback)
{
    NULL_PARAM_CHECK_VOID(self);
    NULL_PARAM_CHECK_VOID(client_id);
    NULL_PARAM_CHECK_VOID(broker_addr);

    struct mqtt_client* client = (struct mqtt_client*)&self->client;

    // MQTT service configuration
    self->state = MQTT_SERVICE_DISCONNECTED;
    self->callback = callback;
    self->client.context = self;

    // MQTT broker configuration
    struct sockaddr_in *broker4 = (struct sockaddr_in *)&self->broker;
    broker4->sin_family = AF_INET;
    broker4->sin_port = htons(broker_port);
    inet_pton(AF_INET, broker_addr, &broker4->sin_addr);

    // MQTT client configuration
    mqtt_client_init(client);
    client->broker = &self->broker;
    client->evt_cb = _mqtt_service_evt_handler;
    client->client_id.utf8 = (uint8_t*)client_id;
    client->client_id.size = strlen(client_id);
    client->password = NULL;
    client->user_name = NULL;
    client->protocol_version = MQTT_VERSION_3_1_1;
    client->transport.type = MQTT_TRANSPORT_NON_SECURE;

    // MQTT buffers configuration
    client->rx_buf = self->buffer.rx;
    client->rx_buf_size = sizeof(self->buffer.rx);
    client->tx_buf = self->buffer.tx;
    client->tx_buf_size = sizeof(self->buffer.tx); 
}

void mqtt_service_start(struct mqtt_service* self) {
    NULL_PARAM_CHECK_VOID(self);

    self->thread.id = k_thread_create(&self->thread.data,
        self->thread.stack, K_THREAD_STACK_SIZEOF(self->thread.stack),
        _mqtt_service_task, self, NULL, NULL,
        MQTT_SERVICE_PRIO, 0, K_NO_WAIT);
    k_thread_name_set(self->thread.id, "mqtt_service");
}

int mqtt_service_subscribe(struct mqtt_service* self, const char* topic, uint8_t qos, void* data, size_t len) {
    NULL_PARAM_CHECK(self);
    NULL_PARAM_CHECK(topic);

    int rc = 0;
    struct mqtt_client* client = (struct mqtt_client*)&self->client;

    if (data != NULL) {
        rc = mqtt_service_publish(self, topic, MQTT_QOS_0_AT_MOST_ONCE, data, len);
        if (rc != 0) {
            return rc;
        }
    }

    struct mqtt_topic topics[] = {
        { .topic = { .utf8 = (const uint8_t*)topic, .size = strlen(topic) }, .qos = qos },
    };

    struct mqtt_subscription_list subscriptions = {
        .list = topics,
        .list_count = 1,
        .message_id = sys_rand32_get()
    };

    rc = mqtt_subscribe(client, &subscriptions);
    if (rc != 0) {
        LOG_ERR("mqtt_subscribe: %d", rc);
        return rc;
    }

    return 0;
}

int mqtt_service_publish(struct mqtt_service* self, const char* topic, uint8_t qos, void* data, size_t len) {
    NULL_PARAM_CHECK(self);
    NULL_PARAM_CHECK(topic);
    NULL_PARAM_CHECK(data);

    struct mqtt_client* client = (struct mqtt_client*)&self->client;

	struct mqtt_publish_param param;
	param.message.topic.qos = qos;
	param.message.topic.topic.utf8 = (const uint8_t*)topic;
	param.message.topic.topic.size = strlen(topic);
	param.message.payload.data = data;
	param.message.payload.len = len;
	param.message_id = sys_rand32_get();
	param.dup_flag = 0U;
	param.retain_flag = 1U;

	int rc = mqtt_publish(client, &param);
    if (rc != 0) {
        LOG_ERR("mqtt_publish: %d", rc);
    }
    return rc;
}
```

## src/mqtt_service.h
```c
#pragma once

#include <zephyr.h>
#include <net/mqtt.h>

#ifdef __cplusplus
extern "C" {
#endif

#define MQTT_SERVICE_STACK_SIZE 2048
#define MQTT_SERVICE_PRIO 8 
#define MQTT_MAX_TOPIC_LEN 48

enum mqtt_service_state {
    MQTT_SERVICE_DISCONNECTED = 0,
    MQTT_SERVICE_CONNECTED = 1,
};

struct mqtt_service_client {
    struct mqtt_client client;
    void* context;
};

struct mqtt_service;

typedef int(*mqtt_service_callback_t)(
    struct mqtt_service* service, const char* topic, size_t payload_len);

typedef struct mqtt_service {
    struct mqtt_service_client client;
    struct sockaddr_storage broker;

    struct {
        uint8_t rx[256];
        uint8_t tx[256];
    } buffer;

    struct {
        struct k_thread data;
        k_tid_t id;
        K_THREAD_STACK_MEMBER(stack, MQTT_SERVICE_STACK_SIZE);
    } thread;
    
    enum mqtt_service_state state;
    mqtt_service_callback_t callback;
} mqtt_service_t;

void mqtt_service_init(struct mqtt_service* self,
    const char* client_id,
    const char* broker_addr, uint16_t broker_port,
    mqtt_service_callback_t callback);

void mqtt_service_start(struct mqtt_service* self);

int mqtt_service_subscribe(struct mqtt_service* self, const char* topic, uint8_t qos, void* data, size_t len);
int mqtt_service_publish(struct mqtt_service* self, const char* topic, uint8_t qos, void* data, size_t len);

int mqtt_service_read_payload(struct mqtt_service* self, void* buffer, size_t len);

#ifdef __cplusplus
}
#endif
```

## src/network.c
```c
#include <logging/log.h>
LOG_MODULE_REGISTER(network, LOG_LEVEL_INF);

#include <net/net_core.h>
#include <net/net_if.h>
#include <net/net_mgmt.h>

#if !defined(CONFIG_NET_CONFIG_SETTINGS)

static struct net_mgmt_event_callback _network_l2_event_cb;
static void _network_l2_event_handler(struct net_mgmt_event_callback *cb, uint32_t event, struct net_if *iface) {
    switch (event) {
        case NET_EVENT_IF_UP: {
            LOG_INF("Interface: %s up", log_strdup(iface->if_dev->dev->name));
        } return;

        case NET_EVENT_IF_DOWN: {
            LOG_INF("Interface: %s down", log_strdup(iface->if_dev->dev->name));
        } return;
    }
}

#if defined(CONFIG_NET_DHCPV4)

static struct net_mgmt_event_callback _network_l3_event_cb;
static void _network_l3_event_handler(struct net_mgmt_event_callback *cb, uint32_t event, struct net_if *iface) {
    switch (event) {
        case NET_EVENT_IPV4_ADDR_ADD: {
            char hr_addr[NET_IPV4_ADDR_LEN];
            int i = 0;

            for (i = 0; i < NET_IF_MAX_IPV4_ADDR; i++) {
                struct net_if_addr *if_addr = &iface->config.ip.ipv4->unicast[i];
                if (if_addr->addr_type != NET_ADDR_DHCP || !if_addr->is_used) {
                    continue;
                }

                LOG_INF("IPv4 address: %s",
                    log_strdup(net_addr_ntop(AF_INET,
                                &if_addr->address.in_addr,
                                hr_addr, NET_IPV4_ADDR_LEN)));
                LOG_INF("Lease time: %u seconds",
                    iface->config.dhcpv4.lease_time);
                LOG_INF("Subnet: %s",
                    log_strdup(net_addr_ntop(AF_INET,
                                &iface->config.ip.ipv4->netmask,
                                hr_addr, NET_IPV4_ADDR_LEN)));
                LOG_INF("Gateway: %s",
                    log_strdup(net_addr_ntop(AF_INET,
                                &iface->config.ip.ipv4->gw,
                                hr_addr, NET_IPV4_ADDR_LEN)));
                break;
            }
        } return;
    }
}

static void _network_init_ipv4(struct net_if* iface) {
	net_mgmt_init_event_callback(&_network_l3_event_cb, _network_l3_event_handler, NET_EVENT_IPV4_ADDR_ADD);
	net_mgmt_add_event_callback(&_network_l3_event_cb);

    LOG_INF("Starting dhcpv4 client...");
    net_dhcpv4_start(iface);

    LOG_INF("Waiting for IPv4 address to be assigned...");
    net_mgmt_event_wait_on_iface(iface, NET_EVENT_IPV4_ADDR_ADD, NULL, NULL, NULL, K_FOREVER);
}

#else

static void _network_init_ipv4(struct net_if* iface) {
    char hr_addr[NET_IPV4_ADDR_LEN];
	struct in_addr addr;

	if (net_addr_pton(AF_INET, CONFIG_NET_CONFIG_MY_IPV4_ADDR, &addr)) {
		LOG_ERR("Invalid address: %s", CONFIG_NET_CONFIG_MY_IPV4_ADDR);
		return;
	}

	net_if_ipv4_addr_add(iface, &addr, NET_ADDR_MANUAL, 0);
	LOG_INF("IPv4 address: %s",
		log_strdup(net_addr_ntop(AF_INET, &addr, hr_addr,
					 NET_IPV4_ADDR_LEN)));

	if (net_addr_pton(AF_INET, CONFIG_NET_CONFIG_MY_IPV4_GW, &addr)) {
		LOG_ERR("Invalid gateway: %s", CONFIG_NET_CONFIG_MY_IPV4_GW);
		return;
	}

    net_if_ipv4_set_gw(iface, &addr);
    LOG_INF("Gateway: %s",
        log_strdup(net_addr_ntop(AF_INET,
                    &iface->config.ip.ipv4->gw,
                    hr_addr, NET_IPV4_ADDR_LEN)));
}

#endif
#endif

void network_init() {
#if !defined(CONFIG_NET_CONFIG_SETTINGS)
	net_mgmt_init_event_callback(&_network_l2_event_cb, _network_l2_event_handler, NET_EVENT_IF_UP | NET_EVENT_IF_DOWN);
	net_mgmt_add_event_callback(&_network_l2_event_cb);

    struct net_if* iface = net_if_get_default();
    LOG_INF("Waiting for interface %s to be up...", log_strdup(iface->if_dev->dev->name));
    net_mgmt_event_wait_on_iface(iface, NET_EVENT_IF_UP, NULL, NULL, NULL, K_FOREVER);

    _network_init_ipv4(iface);
#endif
}
```

## src/network.h
```c
#pragma once

#ifdef __cplusplus
extern "C" {
#endif

void network_init();

#ifdef __cplusplus
}
#endif
```
